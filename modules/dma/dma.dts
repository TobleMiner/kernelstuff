/dts-v1/;
/plugin/;

/ {
        compatible = "brcm,bcm2835", "brcm,bcm2708", "brcm,bcm2709";

/*		fragment@0 {
			target = <&mmc>;
			__overlay__ {
				status = "disabled";
			};
		};
*/
        fragment@1 {
                target-path = "/";
                __overlay__ {
                        dmatest@0 {
                                status = "okay";
                                compatible = "testing,dma";
                                dmas = <&dma 0x5>;
                                dma-names = "gpio";
                                dma-gpio = <14>;
                        };
                };
        };
};
